## boards/shields/single_ball_erg/Kconfig.defconfig
```kconfig
if SHIELD_SINGLE_BALL_ERG_RIGHT

config ZMK_KEYBOARD_NAME
    default "single_ball_erg"

endif

if SHIELD_SINGLE_BALL_ERG_LEFT || SHIELD_SINGLE_BALL_ERG_RIGHT

config ZMK_SPLIT
    default y

endif
```

## boards/shields/single_ball_erg/Kconfig.shield
```kconfig
config SHIELD_SINGLE_BALL_ERG_LEFT
    def_bool $(shields_list_contains,single_ball_erg_left)
config SHIELD_SINGLE_BALL_ERG_RIGHT
    def_bool $(shields_list_contains,single_ball_erg_right)
```
